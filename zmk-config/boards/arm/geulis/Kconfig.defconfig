## zmk-config/boards/arm/geulis/Kconfig.defconfig
```kconfig
# SPDX-License-Identifier: MIT


if BOARD_GEULIS

config ZMK_KEYBOARD_NAME
	default "Geulis"

if USB

config USB_NRFX
	default y

config USB_DEVICE_STACK
	default y

endif # USB

config BT_CTLR
	default BT

config ZMK_BLE
	default y

config ZMK_USB
	default y

config ZMK_BATTERY_VOLTAGE_DIVIDER
	default y

config ZMK_DISPLAY
	select LVGL_USE_CONT
	select LVGL_FONT_MONTSERRAT_26



if ZMK_DISPLAY
choice LVGL_THEME_DEFAULT_FONT_NORMAL
    default LVGL_THEME_DEFAULT_FONT_NORMAL_MONTSERRAT_26

endchoice

choice LVGL_THEME_DEFAULT_FONT_SMALL
    default LVGL_THEME_DEFAULT_FONT_SMALL_MONTSERRAT_26

endchoice


config LVGL_HOR_RES_MAX
	default 160

config LVGL_VER_RES_MAX
	default 68

config SPI
	default y

config LS0XX
	default y

config LVGL_BITS_PER_PIXEL
	default 1

choice LVGL_COLOR_DEPTH
	default LVGL_COLOR_DEPTH_1

endchoice

config LVGL_DPI
	default 30

config LVGL_VDB_SIZE
	default 16


endif # ZMK_DISPLAY



endif # BOARD_GEULIS
```

## zmk-config/boards/shields/geulis/Kconfig.defconfig
```kconfig
# Copyright (c) 2020 The ZMK Contributors
# SPDX-License-Identifier: MIT

if SHIELD_GEULIS

config ZMK_KEYBOARD_NAME
    default "Geulis"


endif
```
